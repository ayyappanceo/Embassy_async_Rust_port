# THEJAS32 register map
Vendor: CDAC; File version: 1.1
C-DAC VEGA THEJAS32 RV32IM SoC (ARIES v3.0)
CPU: other r1p0, little endian, no MPU, no FPU, 3 interrupt priority bits
Registers are 32-bit, read-write, reset 0x0 unless marked. A register's access mark holds for its fields unless they carry their own. Offsets are from the block's base; lines under a group give offsets from that group; [hi:lo] are bit positions; {n}, {i} and the like mark numbered series; 'fields as' and 'values as' point back to an identical list; <NAME> marks a mode.

## Memory map
0x10000100 UART0 size 0x100 — Universal Asynchronous Receiver/Transmitter 0
0x10000200 SPI0 size 0x100 — Serial Peripheral Interface Master 0
0x10000300 I2C0 size 0x100 — Inter-Integrated Circuit Controller 0
0x10080000 GPIO0 size 0x40004 — General Purpose I/O Controller 0 (Pins 0-15)
0x10180000 GPIO1 — General Purpose I/O Controller 1 (Pins 16-31)

## Interrupts
0 UART0

## UART0 — Universal Asynchronous Receiver/Transmitter 0
Base 0x10000100
0x00 DR — Data / Divisor LSB
0x04 IE — Interrupt Enable / Divisor MSB
0x08 IIR_FCR — IIR / FIFO Control
0x0C LCR — Line Control
0x14 LSR ro — Line Status

## SPI0 — Serial Peripheral Interface Master 0
Base 0x10000200
0x00 CR — Control Register
0x04 SR ro — Status Register
0x08 TXDR — Transmit Data Register
0x0C RXDR ro — Receive Data Register
0x10 BAUD — Clock Prescaler

## I2C0 — Inter-Integrated Circuit Controller 0
Base 0x10000300
0x00 CR — Control Register
0x04 SR ro — Status Register
0x08 SAR — 7-bit Slave Address Register
0x0C DR — Data Register
0x10 PRER — Clock Prescaler Register

## GPIO0 — General Purpose I/O Controller 0 (Pins 0-15)
Base 0x10080000
0x3FFFC DATA_ALL 16-bit — All Pins Data Register
0x40000 DIR 16-bit — Pin Direction Register
